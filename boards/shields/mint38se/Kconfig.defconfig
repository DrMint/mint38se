## boards/shields/mint38se/Kconfig.defconfig
```kconfig
# Copyright (c) 2022 The ZMK Contributors
# SPDX-License-Identifier: MIT

if SHIELD_MINT38SE_LEFT

config ZMK_KEYBOARD_NAME
    default "Mint38SE"

config ZMK_SPLIT_ROLE_CENTRAL
    default y

endif

if SHIELD_MINT38SE_LEFT || SHIELD_MINT38SE_RIGHT

config ZMK_SPLIT
    default y

endif
```

## boards/shields/mint38se/Kconfig.shield
```kconfig
# Copyright (c) 2022 The ZMK Contributors
# SPDX-License-Identifier: MIT

config SHIELD_MINT38SE_LEFT
    def_bool $(shields_list_contains,mint40se_left)

config SHIELD_MINT38SE_RIGHT
    def_bool $(shields_list_contains,mint40se_right)
```
